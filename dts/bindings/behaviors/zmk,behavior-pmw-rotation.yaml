## dts/bindings/behaviors/zmk,behavior-pmw-rotation.yaml
```yaml
description: PMW3610 trackball rotation control behavior

compatible: "zmk,behavior-pmw-rotation"

include: base.yaml

properties:
  "#binding-cells":
    type: int
    const: 0
```
